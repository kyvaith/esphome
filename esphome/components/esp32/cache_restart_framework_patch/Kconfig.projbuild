## esphome/components/esp32/cache_restart_framework_patch/Kconfig.projbuild
```kconfig
config ESPHOME_ESP32P4_CACHE_SAFE_RESTART
    bool "Stall ESP32-P4 peer CPU and drain cache sync before software restart"
    depends on IDF_TARGET_ESP32P4
    default n
    help
        Opt in to the reviewed ESP-IDF 5.5.5 ESP32-P4 restart workaround for
        espressif/esp-idf#19171. Preserve an in-progress shared cache sync by
        stalling the other CPU without first resetting it. Wait until sync
        operation enable bits clear before issuing the restart writeback.
        This wait has no timeout and cannot recover a wedged hardware engine.
```

## esphome/components/esp32/fast_heap_query_framework_patch/Kconfig.projbuild
```kconfig
config ESPHOME_HEAP_FAST_LARGEST_BLOCK
    bool "Enable runtime-selectable bounded largest free block query"
    depends on IDF_TARGET_ESP32P4 && !HEAP_TLSF_USE_ROM_IMPL && HEAP_POISONING_DISABLED
    default n
    help
        Compile the reviewed ESP-IDF 5.5.6 source-TLSF largest-block query.
        Runtime selection starts disabled and requires an explicit setter.
        The original allocator and full heap-info queries remain unchanged.
        Only the fit-rounded largest size is read through the TLSF bitmaps.
```

## esphome/components/esp32/pie_context_framework_patch/Kconfig.projbuild
```kconfig
config ESPHOME_ESP32P4_PIE_CONTEXT_FIX
    bool "Use the reviewed ESP32-P4 PIE register context backport"
    depends on IDF_TARGET_ESP32P4
    default n
    help
        Opt in to the ESP-IDF PIE save/restore correction from official commit
        b25cb2906c7db70a86332dffbe77df64345d8a73. Preserve Q3 and correctly
        pack and restore XACC, SAR, SAR_BYTES and FFT_BIT_WIDTH. The original
        reviewed ESP-IDF 5.5.5/5.5.6 source remains active when disabled.
```

## esphome/components/esp32_hosted/sdmmc_framework_patch/Kconfig.projbuild
```kconfig
config ESPHOME_SDMMC_PRESERVE_TRANSACTION_ERROR
    bool "Preserve SDMMC transaction errors across final cache synchronization"
    default n
    help
        Backport the error precedence from Espressif commit 5038e2ad.
        Cache synchronization still executes after a failed transaction.
        Only an otherwise successful transaction adopts its final sync result.
```

## esphome/components/mipi_dsi/mipi_dsi_framework_patch/Kconfig.projbuild
```kconfig
config ESPHOME_PPA_WAIT_DIAGNOSTICS
    bool "ESPHome PPA completion wait diagnostics"
    depends on IDF_TARGET_ESP32P4
    default n
    help
        Retain a bounded numeric DMA2D interrupt journal and report PPA waits
        longer than one second. This does not complete, cancel, or recover a
        stalled transaction. An explicit diagnostic API may force SRM macroblock
        bypass only for an unrotated RGB888 1:1 FIFO equality case.
        Intended for diagnosis with the reviewed ESP-IDF 5.5.6 SDK only.
```

## esphome/components/sendspin/sendspin_memory_patch/Kconfig.projbuild
```kconfig
config ESPHOME_SENDSPIN_MEMORY_OPTIMIZATIONS
    bool "Size PCM receive overhead from its format and release idle artwork assemblies"
    default n
    help
        Preserve Sendspin audio quotas, message limits and artwork caps while
        deriving the receive hold window from PCM formats when no compressed
        codec is offered. Allocate encoded artwork assemblies only during a
        transfer or a parked acknowledgement, and release after the synchronous
        decode callback or discard. The original 0.9.3 behavior remains when off.
```
